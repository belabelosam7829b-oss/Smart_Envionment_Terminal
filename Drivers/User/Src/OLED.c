#include "OLED.h"
#include "i2c.h"
#include <string.h>

static uint8_t oled_address = 0x78;
static uint8_t OLED_GRAM[128][8];

static const uint8_t F8X16[][16] = {
    {0x00,0x00,0x00,0x00,0x00,0x00,0x00,0x00,0x00,0x00,0x00,0x00,0x00,0x00,0x00,0x00},//
    {0x00,0x00,0x00,0xF8,0x00,0x00,0x00,0x00,0x00,0x00,0x00,0x33,0x30,0x00,0x00,0x00},//!
    {0x00,0x10,0x0C,0x06,0x10,0x0C,0x06,0x00,0x00,0x00,0x00,0x00,0x00,0x00,0x00,0x00},//"
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    {0x00,0x06,0x01,0x01,0x02,0x02,0x04,0x04,0x00,0x00,0x00,0x00,0x00,0x00,0x00,0x00}  //~
};

static void OLED_WriteCmd(uint8_t cmd) {
    uint8_t data[2] = {0x00, cmd};
    HAL_I2C_Master_Transmit(&hi2c1, oled_address, data, 2, HAL_MAX_DELAY);
}

static void OLED_WriteData(uint8_t data) {
    uint8_t buf[2] = {0x40, data};
    HAL_I2C_Master_Transmit(&hi2c1, oled_address, buf, 2, HAL_MAX_DELAY);
}

static void OLED_DetectAddress(void) {
    if (HAL_I2C_IsDeviceReady(&hi2c1, 0x78, 3, 100) == HAL_OK) {
        oled_address = 0x78;
        return;
    }
    if (HAL_I2C_IsDeviceReady(&hi2c1, 0x7A, 3, 100) == HAL_OK) {
        oled_address = 0x7A;
        return;
    }
}

void OLED_Init(void) {
    HAL_Delay(500);
    OLED_DetectAddress();
    OLED_WriteCmd(0xAE); OLED_WriteCmd(0xD5); OLED_WriteCmd(0x80);
    OLED_WriteCmd(0xA8); OLED_WriteCmd(0x3F); OLED_WriteCmd(0xD3);
    OLED_WriteCmd(0x00); OLED_WriteCmd(0x40); OLED_WriteCmd(0x8D);
    OLED_WriteCmd(0x14); OLED_WriteCmd(0x20); OLED_WriteCmd(0x02);
    OLED_WriteCmd(0xA1);
    OLED_WriteCmd(0xC8);
    OLED_WriteCmd(0xDA); OLED_WriteCmd(0x12); OLED_WriteCmd(0x81);
    OLED_WriteCmd(0xCF); OLED_WriteCmd(0xD9); OLED_WriteCmd(0xF1);
    OLED_WriteCmd(0xDB); OLED_WriteCmd(0x40); OLED_WriteCmd(0xA4);
    OLED_WriteCmd(0xA6); OLED_WriteCmd(0xAF);
    OLED_Clear();
    OLED_UpdateScreen();
}

void OLED_Clear(void) {
    memset(OLED_GRAM, 0, sizeof(OLED_GRAM));
}

void OLED_UpdateScreen(void) {
    for (uint8_t i = 0; i < 8; i++) {
        OLED_WriteCmd(0xB0 + i);
        OLED_WriteCmd(0x00);
        OLED_WriteCmd(0x10);
        for (uint8_t n = 0; n < 128; n++) {
            OLED_WriteData(OLED_GRAM[n][i]);
        }
    }
}

void OLED_DrawPoint(uint8_t x, uint8_t y, uint8_t mode) {
    if (x > 127 || y > 63) return;
    if (mode) OLED_GRAM[x][y / 8] |= (1 << (y % 8));
    else OLED_GRAM[x][y / 8] &= ~(1 << (y % 8));
}

void OLED_ShowChar(uint8_t x, uint8_t y, char ch) {
    if (ch < ' ' || ch > '~') return;
    uint8_t c = ch - ' ';
    uint8_t page = y / 8;
    for (uint8_t i = 0; i < 8; i++) {
        if (page < 8) OLED_GRAM[x + i][page] = F8X16[c][i];
        if (page + 1 < 8) OLED_GRAM[x + i][page + 1] = F8X16[c][i + 8];
    }
}

void OLED_ShowString(uint8_t x, uint8_t y, const char *str) {
    while (*str) {
        OLED_ShowChar(x, y, *str++);
        x += 8;
        if (x > 120) { x = 0; y += 16; }
    }
}