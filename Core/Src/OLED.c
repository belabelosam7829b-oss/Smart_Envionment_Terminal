#include "OLED.h"
#include "i2c.h"
#include <string.h>

#define OLED_ADDRESS  0x78

static uint8_t OLED_GRAM[128][8];

static const uint8_t F8X16[][16] = {
    {0x00,0x00,0x00,0x00,0x00,0x00,0x00,0x00,0x00,0x00,0x00,0x00,0x00,0x00,0x00,0x00}, /*  */
    {0x00,0x00,0x00,0x00,0x00,0x00,0x00,0x00,0x00,0x00,0x00,0x00,0x00,0x00,0x00,0x00}, /* ! */
    {0x00,0x00,0x00,0x00,0x00,0x00,0x00,0x00,0x00,0x00,0x00,0x00,0x00,0x00,0x00,0x00}, /* " */
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    {0x00,0x00,0x86,0x8A,0x92,0xA2,0xC2,0x00,0x00,0x08,0x09,0x0A,0x0C,0x08,0x00,0x00}  /* Z */
};

static void OLED_WriteCmd(uint8_t cmd) {
    uint8_t data[2] = {0x00, cmd};
    HAL_I2C_Master_Transmit(&hi2c1, OLED_ADDRESS, data, 2, HAL_MAX_DELAY);
}

static void OLED_WriteData(uint8_t data) {
    uint8_t buf[2] = {0x40, data};
    HAL_I2C_Master_Transmit(&hi2c1, OLED_ADDRESS, buf, 2, HAL_MAX_DELAY);
}

void OLED_Init(void) {
    HAL_Delay(100);
    OLED_WriteCmd(0xAE);
    OLED_WriteCmd(0xD5);
    OLED_WriteCmd(0x80);
    OLED_WriteCmd(0xA8);
    OLED_WriteCmd(0x3F);
    OLED_WriteCmd(0xD3);
    OLED_WriteCmd(0x00);
    OLED_WriteCmd(0x40);
    OLED_WriteCmd(0x8D);
    OLED_WriteCmd(0x14);
    OLED_WriteCmd(0x20);
    OLED_WriteCmd(0x02);
    OLED_WriteCmd(0xA1);
    OLED_WriteCmd(0xC8);
    OLED_WriteCmd(0xDA);
    OLED_WriteCmd(0x12);
    OLED_WriteCmd(0x81);
    OLED_WriteCmd(0xEF);
    OLED_WriteCmd(0xD9);
    OLED_WriteCmd(0xF1);
    OLED_WriteCmd(0xDB);
    OLED_WriteCmd(0x40);
    OLED_WriteCmd(0xA4);
    OLED_WriteCmd(0xA6);
    OLED_WriteCmd(0xAF);
    OLED_Clear();
    OLED_UpdateScreen();
}

void OLED_Clear(void) {
    memset(OLED_GRAM, 0, sizeof(OLED_GRAM));
}

void OLED_UpdateScreen(void) {
    uint8_t i, n;
    for (i = 0; i < 8; i++) {
        OLED_WriteCmd(0xB0 + i);
        OLED_WriteCmd(0x00);
        OLED_WriteCmd(0x10);
        for (n = 0; n < 128; n++) {
            OLED_WriteData(OLED_GRAM[n][i]);
        }
    }
}

void OLED_DrawPoint(uint8_t x, uint8_t y, uint8_t mode) {
    uint8_t pos, bx, temp;
    if (x > OLED_WIDTH - 1 || y > OLED_HEIGHT - 1) return;
    pos = y / 8;
    bx = y % 8;
    temp = 1 << (7 - bx);
    if (mode) OLED_GRAM[x][pos] |= temp;
    else OLED_GRAM[x][pos] &= ~temp;
}

void OLED_ShowChar(uint8_t x, uint8_t y, char ch, uint8_t size) {
    uint8_t temp, t, t1;
    uint8_t y0 = y;
    
    if (ch >= 'A' && ch <= 'Z') {
        ch = ch - 'A' + 33; // 在我们的数组中，A从33开始
    } else if (ch == ':') {
        ch = 26; // 冒号位置
    } else if (ch == ' ') {
        ch = 0; // 空格
    } else {
        ch = 0; // 默认为空格
    }
    
    for (t = 0; t < size; t++) {
        if (size == 12) temp = 0;
        else temp = 1;
        for (t1 = 0; t1 < 8; t1++) {
            if (temp) {
                if (F8X16[(uint8_t)ch][t] & (0x80 >> t1)) OLED_DrawPoint(x, y, 1);
                else OLED_DrawPoint(x, y, 0);
            } else {
                if (F8X16[(uint8_t)ch][t] & (0x80 >> t1)) OLED_DrawPoint(x, y, 1);
                else OLED_DrawPoint(x, y, 0);
            }
            y++;
            if (y >= OLED_HEIGHT) return;
            if (y - y0 == size) {
                y = y0;
                x++;
                if (x >= OLED_WIDTH) return;
                break;
            }
        }
    }
}

void OLED_ShowString(uint8_t x, uint8_t y, const char *str, uint8_t size) {
    while (*str != '\0') {
        OLED_ShowChar(x, y, *str, size);
        x += 8;
        if (x > 120) {
            x = 0;
            y += size;
        }
        str++;
    }
}
